## package/htop/Config.in
```kconfig
config BR2_PACKAGE_HTOP
        bool "htop"
  select BR2_PACKAGE_NCURSES
        help
    Htop is an ncursed-based process viewer similar to top, but it allows to scroll the list vertically and horizontally to see all processes and their full command lines.
    Tasks related to processes (killing, renicing) can be done without entering their PIDs.

    http://htop.sourceforge.net/
```

## package/mc/Config.in
```kconfig
config BR2_PACKAGE_MC
	bool "mc - Midnight Commander"
	select BR2_PACKAGE_LIBGLIB2
	select BR2_PACKAGE_SLANG2
	select BR2_PACKAGE_E2FSPROGS
	help
	  midnight commander - a powerful file manager

	  http://www.midnight-commander.org/

 config BR2_PACKAGE_MC_STATIC
   bool "Build mc as a static binary (no shared libs)"
   depends on BR2_PACKAGE_MC
   default n
   help
    If you want to build a static mc binary, which does not
    use or require any shared libraries, then enable this option.
    This can cause mc to be considerably larger, so you should
    leave this option false unless you have a good reason (i.e.
    your target platform does not support shared libraries, or
    you are building an initrd which doesn't need anything but
    mc, etc).

    Most people will leave this set to 'N'.

 config BR2_PACKAGE_MC_ANDROID
   bool "Patch midnight commander for Android custom ROM"
   depends on BR2_PACKAGE_MC
   default n
   help
    Patch mc for Android specific terminfo location
```

## package/opkg/Config.in
```kconfig
config BR2_PACKAGE_OPKG
	bool "opkg"
	help
	  Opkg is a lightweight package management system based on Ipkg.

	  http://code.google.com/p/opkg/
```

## package/slang2/Config.in
```kconfig
config BR2_PACKAGE_SLANG2
	bool "slang2"
	select BR2_PACKAGE_PCRE
	select BR2_PACKAGE_LIBPNG
  select BR2_PACKAGE_LIBICONV
	help
	  Multi-platform console display library.
	  Version 2
	
	  http://www.s-lang.org/
```

## package/tree/Config.in
```kconfig
config BR2_PACKAGE_TREE
        bool "tree"
        help
    Tree is a recursive directory listing program that produces a depth indented listing of files, which is colorized ala dircolors if the LS_COLORS environment variable is set and output is to tty.

    http://mama.indstate.edu/users/ice/tree
```

## package/zip/Config.in
```kconfig
config BR2_PACKAGE_ZIP
	bool "zip"
	help
	  Zip is a compression and file packaging/archive utility

	  http://www.info-zip.org/Zip.htm
```

## toolchain/ipkg-utils/Config.in
```kconfig
config BR2_PACKAGE_HOST_IPKG_UTILS
	bool "Install ipkg-utils for the host/build system"
	help
	  Host scripts for building .ipk packages for the ipkg system.

	  http://www.handhelds.org/download/packages/ipkg-utils/
```
